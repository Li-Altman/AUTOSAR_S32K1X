AUTOSAR XML (schema 4-2-1)
package /COM/VECTOR/CFG/WORKFLOW/SYSDESC/SYNC
  flat map FLATMAP
    5 x flat instance descriptor:
      Sig_Light_1_Ctrl: upstream-reference=EcuSwComposition.Sig_Light_1_Ctrl.Sig_Light_1_Ctrl, ecu-extract-reference=COMPOSITIONTYPE.Sig_Light_1_Ctrl.Sig_Light_1_Ctrl
      Sig_Light_1_Ctrl_001: upstream-reference=EcuSwComposition.Sig_Light_1_Ctrl, ecu-extract-reference=COMPOSITIONTYPE.Sig_Light_1_Ctrl
      Sig_Light_1_Sts: upstream-reference=EcuSwComposition.Sig_Light_1_Sts.Sig_Light_1_Sts, ecu-extract-reference=COMPOSITIONTYPE.Sig_Light_1_Sts.Sig_Light_1_Sts
      Sig_Light_1_Sts_001: upstream-reference=EcuSwComposition.Sig_Light_1_Sts, ecu-extract-reference=COMPOSITIONTYPE.Sig_Light_1_Sts
      ECU_APPM: upstream-reference=EcuSwComposition.ECU_APPM, ecu-extract-reference=COMPOSITIONTYPE.ECU_APPM
