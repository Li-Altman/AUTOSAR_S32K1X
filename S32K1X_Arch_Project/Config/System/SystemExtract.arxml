AUTOSAR XML (schema 4-2-1)
# Copyright (c) 2018 Vector Informatik GmbH.
# License is restricted to the usage with CBD1800257 (D01) for MSR_Vector_SLP4.
# Please contact Vector Informatik whenever you need further information concerning the license conditions.
standard types defined: uint8
package /VehicleProject
  system System
package /NM
  nm config NmConfig: can-nm-cluster-coupling=coupled-cluster=N_CAN1_CAN
    can nm cluster N_CAN1_CAN: communication-cluster=N_CAN1, nm-channel-id=0, nm-msg-cycle-time=0.1, nm-network-timeout=1, nm-repeat-message-time=0.4, nm-user-data-length=6, nm-wait-bus-sleep-time=0.75
      can nm node BCM: controller=CT_N_CAN1, nm-if-ecu=BCM_CAN, nm-node-id=0, nm-passive-mode-enabled=true, nm-msg-cycle-offset=0, nm-msg-reduced-time=0.05, nm-range-config={lower-can-id=1024, upper-can-id=1087}
      can nm node Gateway: nm-if-ecu=Gateway_CAN, nm-node-id=0, nm-passive-mode-enabled=true, nm-msg-cycle-offset=0, nm-msg-reduced-time=0.05, nm-range-config={lower-can-id=1024, upper-can-id=1087}
    nm-if-ecus:
      nm ecu BCM_CAN: ecu-instance=BCM, nm-node-id-enabled=true, nm-passive-mode-enabled=true, nm-user-data-enabled=true
      nm ecu Gateway_CAN: nm-node-id-enabled=true, nm-passive-mode-enabled=true, nm-user-data-enabled=true
package /Cluster
  can cluster N_CAN1: baudrate=500000, protocol-name=CAN
    can physical channel CHNL: comm-connectors=CN_N_CAN1
      frame BCM1_1_oN_CAN1: id 0x200, from BCM, frame-length=8, can-addressing-mode=STANDARD
        pdu BCM1_1_oN_CAN1: length=8, minimum-delay=0, transmission-mode-false-timing=cyclic-timing={time-offset=0, time-period=0.1}, transmission-mode-true-timing=cyclic-timing={time-offset=0, time-period=0.1}, unused-bit-pattern=0
          signal Sig_Light_1_Sts_oBCM1_1_oN_CAN1: start 7, 8 bit, big-endian, init-value=0, base-type=uint8, range raw 0..255, transfer-property=PENDING
      frame Gateway_1_oN_CAN1: id 0x100, to BCM, frame-length=8, can-addressing-mode=STANDARD
        pdu Gateway_1_oN_CAN1: length=8, minimum-delay=0, transmission-mode-false-timing=cyclic-timing={time-offset=0, time-period=0.1}, transmission-mode-true-timing=cyclic-timing={time-offset=0, time-period=0.1}, unused-bit-pattern=0
          signal Sig_Light_1_Ctrl_oGateway_1_oN_CAN1: start 7, 8 bit, big-endian, init-value=0, base-type=uint8, range raw 0..255, transfer-property=PENDING, to BCM
package /ECU
  ecu instance BCM: associated-com-i-pdu-group=[BCM_oN_CAN1_Rx, BCM_oN_CAN1_Tx]
    can communication controller CT_N_CAN1
    can communication connector CN_N_CAN1: comm-controller=CT_N_CAN1
package /IPDUGroup
  i signal i pdu group BCM_oN_CAN1_Rx: communication-direction=IN, i-signal-i-pdus=Gateway_1_oN_CAN1
  i signal i pdu group BCM_oN_CAN1_Tx: communication-direction=OUT, i-signal-i-pdus=BCM1_1_oN_CAN1
