AUTOSAR XML (schema 00048)
package /DataTypes/DataConstrs
  range Sig_Light_1_Ctrl: raw 0..255
  range Sig_Light_1_Sts: raw 0..255
