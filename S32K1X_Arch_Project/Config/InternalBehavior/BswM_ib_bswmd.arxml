AUTOSAR XML (schema 4-2-1)
package /MICROSAR
  bsw implementation BswM_Impl: programming-language=C, sw-version=10.03.00, used-code-generator=DaVinci Configurator, vendor-id=30, ar-release-version=4.00.03
package /MICROSAR/BswM_ib_bswmd/BswModuleDescriptions
  bsw module description BswM
    bsw internal behavior BswMBehavior
      exclusive area BSWM_EXCLUSIVE_AREA_0
