AUTOSAR XML (schema 4-2-1)
package /ActiveEcuC
  module config Os: implementation-config-variant=VARIANT-PRE-COMPILE, module-description=Os_Impl
    OsPublishedInformation: OsKernelVersion=7, OsPlatformName=Arm
      S32K148 (OsDerivativeInformation):
        OsMpuAlignment = 32
        OsStackAlignment = 32
        OsExceptionVectorTableAlignment = 0
        OsInterruptVectorTableAlignment = 128
        OsHardwareManuals = NXP/Freescale - S32K14x Series Reference Manual - Supports S32K142, S32K144, S32K146, and S32K148 Document Number: S32K14XRM - Rev. 3, 03/2017
        INTC (OsSystemIntCtrl):
          OsSystemIntCtrlMaxPrios = 224
          OsSystemIntCtrlMaxSources = 240
          OsSystemIntCtrlPrioOrder = DESC
          OsSystemIntCtrlBaseAddress = 3758153728
          OsSystemIntCtrlType = NVIC
        Core0 (OsPhysicalCore):
          OsPhysicalCoreId = 0
          OsPhysicalCoreExceptionSources = 8
          OsPhysicalCoreIsAutostart = true
          OsPhysicalCoreMasterStartAllowed = false
          OsPhysicalCorePrivelegedHwAccess = true
          OsPhysicalCoreType = Cortex-M
          OsPhysicalCoreDefaultEntrySymbol = _start
          OsPhysicalCoreStackProtectionUnit = SystemMPU0
        SystemMPU0 (OsSystemMpu): OsSystemMpuBaseAddress=1073795072, OsSystemMpuId=0, OsSystemMpuMaxRegions=16, OsSystemMpuType=SYSTEM_MPU_NXP
        OsMemoryRegionDefaults_AppT (OsMemoryRegionDefaults): OsMemoryRegionDefType=APPLICATION_TRUSTED, OsMemoryRegionDefAccessRights=SUPERVISOR_RWX, OsMemoryRegionDefBusMasters=Core
        OsMemoryRegionDefaults_AppNT (OsMemoryRegionDefaults):
          OsMemoryRegionDefType = APPLICATION_NONTRUSTED
          OsMemoryRegionDefBusMasters = Core
          OsMemoryRegionDefAccessRights = USER_R
          OsMemoryRegionDefAccessRights = USER_W
        OsMemoryRegionSpecifics
          4 x OsMemoryRegionAccess:
            USER_X: OsMemoryRegionAccessRights=X, OsMemoryRegionAccessType=USER
            USER_W: OsMemoryRegionAccessRights=W, OsMemoryRegionAccessType=USER
            SUPERVISOR_RX: OsMemoryRegionAccessRights=RX, OsMemoryRegionAccessType=SUPERVISOR
            SUPERVISOR_RW: OsMemoryRegionAccessRights=RW, OsMemoryRegionAccessType=SUPERVISOR
          Debugger (OsMemoryRegionBusMaster): OsMemoryRegionBusMasterId=1
          PID_ENABLE (OsMemoryRegionFlag)
          SUPERVISOR_RWX (OsMemoryRegionAccess): OsMemoryRegionAccessRights=RWX, OsMemoryRegionAccessType=SUPERVISOR
          3 x OsMemoryRegionBusMaster:
            DMA: OsMemoryRegionBusMasterId=2
            Core: OsMemoryRegionBusMasterId=0
            ENET: OsMemoryRegionBusMasterId=3
          USER_R (OsMemoryRegionAccess): OsMemoryRegionAccessRights=R, OsMemoryRegionAccessType=USER
        SysTick (OsHardwareTimer): OsHardwareTimerBaseAddress=3758153744, OsHardwareTimerId=0, OsHardwareTimerSize=24, OsHardwareTimerUnit=PIT, OsHardwareTimerType=SysTick
          SysTick_Ch0 (OsHardwareTimerChannel): OsHardwareTimerChannelId=0, OsHardwareTimerChannelIntSource=15, OsHardwareTimerChannelOffset=0
        DEFAULT (OsInterruptSupportedType): OsInterruptSupportedTypeSeparateSources=false
    OS_APPMODE_ANY (OsAppMode)
    OSDEFAULTAPPMODE (OsAppMode)
    OsOS:
      OsGenerateMemMapForNearAddressing = false
      OsStackMonitoring = true
      OsStatus = EXTENDED
      OsUseGetServiceId = false
      OsUseParameterAccess = false
      OsUseResScheduler = false
      OsForcibleTermination = false
      OsGenerateCalloutStubs = true
      OsGenerateMemMap = COMPLETE
      OsGenerateMemMapForThreads = false
      OsServiceProtection = false
      OsStackUsageMeasurement = false
      OsUseXSignalAsyncApiCalls = false
      OsFpuUsage = NONE
      OsNumberOfCores = 1
      OsScalabilityClass = SC1
      OsMasterCore = OsCore0
      OsStackSummary
        7 x OsStack, all with OsStackCore=OsCore0:
          OsCore0_Error: OsStackSize=1024, OsStackType=CORE_ERROR_STACK, OsStackUser=OsCore0
          OsCore0_Init: OsStackSize=1024, OsStackType=CORE_INIT_STACK, OsStackUser=OsCore0
          OsCore0_Kernel: OsStackSize=1024, OsStackType=CORE_KERNEL_STACK, OsStackUser=OsCore0
          OsCore0_Isr_Core: OsStackSize=1024, OsStackType=ISR_SHARED_CORE_STACK, OsStackUser=CanIsr_0_MB00To15, OsStackUser=CanIsr_0_BusOff, OsStackUser=CanIsr_0_MB16To31, OsStackUser=CounterIsr_OsCounter
          OsCore0_Task_Prio4294967295: OsStackSize=1024, OsStackType=TASK_SHARED_PRIORITY_STACK, OsStackUser=IdleTask_OsCore0
          RunTask_OsCore0: OsStackSize=2048, OsStackType=TASK_SHARED_PRIORITY_STACK, OsStackUser=Os/RunTask_OsCore0
          OsCore0_Task_Prio25: OsStackSize=2048, OsStackType=TASK_SHARED_PRIORITY_STACK, OsStackUser=OsTask_APP_10ms_1
      OsHooks: OsErrorHook=true, OsPostTaskHook=false, OsPreTaskHook=false, OsShutdownHook=false, OsStartupHook=false
    3 x OsIsr, all with OsIsrCategory=CATEGORY_2, OsIsrInterruptType=EXTERNAL, OsIsrStackSize=1024, OsIsrEnableNesting=false, OsIsrUsesFpu=false, OsIsrInterruptMapping=DEFAULT:
      CanIsr_0_BusOff: OsIsrInterruptSource=94, OsIsrInterruptPriority=60, OsIsrSpecialFunctionName=CanBusOffIsr_0  # /ActiveEcuC/Can PLAIN_TEXT CAN BusOff Interrupt. This OsIsr container has been created automatically based on the driver configuration.
      CanIsr_0_MB16To31: OsIsrInterruptSource=98, OsIsrInterruptPriority=62, OsIsrSpecialFunctionName=CanMailboxIsr_0  # /ActiveEcuC/Can PLAIN_TEXT CAN Tx and Rx Interrupt. This OsIsr container has been created automatically based on the driver configuration.
      CanIsr_0_MB00To15: OsIsrInterruptSource=97, OsIsrInterruptPriority=61, OsIsrSpecialFunctionName=CanMailboxIsr_0  # /ActiveEcuC/Can PLAIN_TEXT CAN Tx and Rx Interrupt. This OsIsr container has been created automatically based on the driver configuration.
    OsCore0 (OsCore):
      OsCoreIsAutostart = true
      OsCoreIsAutosar = true
      OsCoreEntrySymbol = Reset_Handler
      OsCorePhysicalCoreRef = Core0
      OsCoreEcucCoreRef = EcucCoreDefinition
      OsCoreIdleTask = IdleTask_OsCore0
      OsCoreSystemApplication = SystemApplication_OsCore0
      OsCoreStacks:
        OsCoreKernelStackSize = 1024
        OsCoreStartupStackSize = 1024
        OsCoreShutdownStackSize = 1024
        OsCoreErrorStackSize = 1024
        OsCoreProtectionStackSize = 1024
        OsCoreInitStackSize = 1024
    IdleTask_OsCore0 (OsTask):
      OsTaskActivation = 1
      OsTaskPriority = 4294967295
      OsTaskSchedule = FULL
      OsTaskStackSharing = false
      OsTaskStackSize = 1024
      OsTaskType = AUTO
      OsTaskUsesFpu = false
      OsTaskAccessingApplication = SystemApplication_OsCore0
      OsTaskResourceRef = OsResource
      OsTaskAutostart: OsTaskAppModeRef=OS_APPMODE_ANY
    SystemApplication_OsCore0 (OsApplication):
      OsTrusted = true
      OsTrustedApplicationDelayTimingViolationCall = false
      OsTrustedApplicationWithProtection = false
      OsApplicationIsPrivileged = true
      OsAppUseTrustedFunctionStubs = false
      OsApplicationCoreRef = EcucCoreDefinition
      OsAppIsrRef = CanIsr_0_BusOff
      OsAppIsrRef = CanIsr_0_MB00To15
      OsAppIsrRef = CanIsr_0_MB16To31
      OsAppTaskRef = IdleTask_OsCore0
      OsAppCounterRef = OsCounter
      OsAppIsrRef = CounterIsr_OsCounter
      OsAppTaskRef = Os/RunTask_OsCore0
      OsAppAlarmRef = Rte_Al_TE2_RunTask_OsCore0_0_10ms
      OsAppAlarmRef = Rte_Al_TE2_RunTask_OsCore0_0_20ms
      OsAppAlarmRef = Rte_Al_TE_BswM_BswM_MainFunction
      OsAppTaskRef = OsTask_APP_10ms_1
      OsAppAlarmRef = Rte_Al_TE_ECU_APPM_ECU_APPM_Runnable
      OsApplicationHooks: OsAppErrorHook=false, OsAppShutdownHook=false, OsAppStartupHook=false
    OsCounter:
      OsCounterMaxAllowedValue = 1073741823
      OsCounterMinCycle = 1
      OsCounterTicksPerBase = 80000
      OsCounterType = HARDWARE
      OsSecondsPerTick = 0.001
      OsCounterAccessingApplication = SystemApplication_OsCore0
      OsDriver: OsDriverHighResolution=false, OsDriverHardwareTimerChannelRef=SysTick_Ch0, OsDriverIsrRef=CounterIsr_OsCounter
    CounterIsr_OsCounter (OsIsr):
      OsIsrCategory = CATEGORY_2
      OsIsrInterruptType = EXTERNAL
      OsIsrInterruptSource = 15
      OsIsrInterruptPriority = 32
      OsIsrStackSize = 1024
      OsIsrEnableNesting = false
      OsIsrUsesFpu = false
      OsIsrSpecialFunctionName = Os_TimerPitIsr
      OsIsrInterruptMapping = DEFAULT
    OsResource: OsResourceProperty=STANDARD, OsResourceAccessingApplication=SystemApplication_OsCore0
    RunTask_OsCore0 (OsTask):
      OsTaskActivation = 1
      OsTaskPriority = 20
      OsTaskSchedule = FULL
      OsTaskStackSharing = false
      OsTaskStackSize = 2048
      OsTaskType = AUTO
      OsTaskUsesFpu = false
      OsTaskAccessingApplication = SystemApplication_OsCore0
      OsTaskEventRef = Rte_Ev_Cyclic2_RunTask_OsCore0_0_10ms
      OsTaskEventRef = Rte_Ev_Cyclic2_RunTask_OsCore0_0_20ms
      OsTaskEventRef = Rte_Ev_Run_BswM_BswM_MainFunction
    Rte_Al_TE2_RunTask_OsCore0_0_10ms (OsAlarm): OsAlarmCounterRef=OsCounter, OsAlarmAccessingApplication=SystemApplication_OsCore0
      OsAlarmAction
        OsAlarmSetEvent: OsAlarmSetEventRef=Rte_Ev_Cyclic2_RunTask_OsCore0_0_10ms, OsAlarmSetEventTaskRef=Os/RunTask_OsCore0
    Rte_Al_TE2_RunTask_OsCore0_0_20ms (OsAlarm): OsAlarmCounterRef=OsCounter, OsAlarmAccessingApplication=SystemApplication_OsCore0
      OsAlarmAction
        OsAlarmSetEvent: OsAlarmSetEventRef=Rte_Ev_Cyclic2_RunTask_OsCore0_0_20ms, OsAlarmSetEventTaskRef=Os/RunTask_OsCore0
    Rte_Ev_Cyclic2_RunTask_OsCore0_0_10ms (OsEvent)
    Rte_Ev_Cyclic2_RunTask_OsCore0_0_20ms (OsEvent)
    Rte_Al_TE_BswM_BswM_MainFunction (OsAlarm): OsAlarmCounterRef=OsCounter, OsAlarmAccessingApplication=SystemApplication_OsCore0
      OsAlarmAction
        OsAlarmSetEvent: OsAlarmSetEventRef=Rte_Ev_Run_BswM_BswM_MainFunction, OsAlarmSetEventTaskRef=Os/RunTask_OsCore0
    Rte_Ev_Run_BswM_BswM_MainFunction (OsEvent)
    OsTask_APP_10ms_1 (OsTask):
      OsTaskActivation = 1
      OsTaskPriority = 25
      OsTaskSchedule = FULL
      OsTaskStackSharing = false
      OsTaskStackSize = 2048
      OsTaskType = AUTO
      OsTaskUsesFpu = false
      OsTaskAccessingApplication = SystemApplication_OsCore0
    Rte_Al_TE_ECU_APPM_ECU_APPM_Runnable (OsAlarm): OsAlarmCounterRef=OsCounter, OsAlarmAccessingApplication=SystemApplication_OsCore0
      OsAlarmAction
        OsAlarmActivateTask: OsAlarmActivateTaskRef=OsTask_APP_10ms_1
