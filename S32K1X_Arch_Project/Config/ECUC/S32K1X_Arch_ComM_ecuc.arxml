AUTOSAR XML (schema 4-2-1)
package /ActiveEcuC
  module config ComM: implementation-config-variant=VARIANT-PRE-COMPILE, module-description=ComM_Impl
    ComMGeneral:
      ComMPncIdCounting = COMM_PNC_ID_COUNT_FROM_NM_MESSAGE
      ComMPncSupport = false
      ComMDevErrorDetect = false
      ComMEcuGroupClassification = 3
      ComMModeLimitationEnabled = true
      ComMSynchronousWakeUp = true
      ComMTMinFullComModeDuration = 5
      ComMVersionInfoApi = false
      ComMWakeupInhibitionEnabled = false
      ComMSafeBswChecks = false
      ComMGeneration: ComMOutOfBoundsWriteSanitizer=false, ComMOutOfBoundsReadSanitizer=false
    ComMConfigSet: ComMPncEnabled=false
      CN_N_CAN1_3b6df477 (ComMChannel):
        ComMBusType = COMM_BUS_TYPE_CAN
        ComMChannelId = 0
        ComMFullCommRequestNotificationEnabled = false
        ComMMainFunctionPeriod = 0.02
        ComMNoCom = true
        ComMNoWakeup = false
        ComMNetworkManagement: ComMNmVariant=NONE, ComMPncNmRequest=false
        CN_N_CAN1_b3186b7e (ComMUserPerChannel): ComMUserChannel=CN_N_CAN1_e2dd2bfb
      CN_N_CAN1_e2dd2bfb (ComMUser): ComMUserIdentifier=0, ComMUserModeNotification=false
