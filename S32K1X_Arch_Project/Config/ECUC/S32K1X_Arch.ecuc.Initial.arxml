AUTOSAR XML (schema 4-2-1)
package /InitialEcuC
  ecuc value collection InitialEcuC: ecuc-values=[Base, Can, CanIf, CanNm, CanSM, Com, ComM, Dio, EcuC, EcuM, Mcu, Nm, PduR, Port, Resource]
  module config Base
    CommonPublishedInformation:  # Project Standard Configuration
      ArReleaseMajorVersion = 4
      ArReleaseMinorVersion = 2
      ArReleaseRevisionVersion = 2
      ModuleId = 0
      SwMajorVersion = 1
      SwMinorVersion = 0
      SwPatchVersion = 1
      VendorId = 43
  module config Can
    CanConfigSet
      CT_N_CAN1_d616d994 (CanController):
        CanControllerActivation = true
        CanControllerDefaultBaudrate = CanControllerBaudrateConfig
        CanControllerSystemRef = CT_N_CAN1
        CanWakeupSourceRef = EcuMCommonConfiguration/CN_N_CAN1_3b6df477
        CanControllerBaudrateConfig: CanControllerBaudRate=500
      CN_N_CAN1_3b6df477_Tx (CanHardwareObject): CanHandleType=BASIC, CanIdValue=0, CanObjectType=TRANSMIT, CanControllerRef=CanConfigSet/CT_N_CAN1_d616d994
      CN_N_CAN1_933b604c_Rx (CanHardwareObject): CanHandleType=BASIC, CanIdType=STANDARD, CanIdValue=0, CanObjectType=RECEIVE, CanControllerRef=CanConfigSet/CT_N_CAN1_d616d994
    CanGeneral: CanIndex=0
  module config CanIf
    CanIfCtrlDrvCfg_7d254554 (CanIfCtrlDrvCfg): CanIfCtrlDrvInitHohConfigRef=CanIfInitHohCfg, CanIfCtrlDrvNameRef=CanGeneral
      CT_N_CAN1_d616d994 (CanIfCtrlCfg): CanIfCtrlCanCtrlRef=CanConfigSet/CT_N_CAN1_d616d994
    CanIfInitCfg
      CHNL_9e0fa25a (CanIfBufferCfg): CanIfBufferSize=0, CanIfBufferHthRef=CanIfInitHohCfg/CN_N_CAN1_3b6df477_Tx
      CanIfInitHohCfg: CanIfInitRefCfgSet=CanConfigSet
        CN_N_CAN1_933b604c_Rx (CanIfHrhCfg): CanIfHrhCanCtrlIdRef=CanIfCtrlDrvCfg_7d254554/CT_N_CAN1_d616d994, CanIfHrhIdSymRef=CanConfigSet/CN_N_CAN1_933b604c_Rx
        CN_N_CAN1_3b6df477_Tx (CanIfHthCfg): CanIfHthCanCtrlIdRef=CanIfCtrlDrvCfg_7d254554/CT_N_CAN1_d616d994, CanIfHthIdSymRef=CanConfigSet/CN_N_CAN1_3b6df477_Tx
      Gateway_1_oN_CAN1_6d05593c_Rx (CanIfRxPduCfg):
        CanIfRxPduCanId = 256
        CanIfRxPduCanIdType = STANDARD_CAN
        CanIfRxPduDlc = 8
        CanIfRxPduUserRxIndicationName = PduR_CanIfRxIndication
        CanIfRxPduUserRxIndicationUL = PDUR
        CanIfRxPduHrhIdRef = CanIfInitHohCfg/CN_N_CAN1_933b604c_Rx
        CanIfRxPduRef = EcucPduCollection/Gateway_1_oN_CAN1_64b0488c_Rx
      BCM1_1_oN_CAN1_e51cf18b_Tx (CanIfTxPduCfg):
        CanIfTxPduCanId = 512
        CanIfTxPduCanIdType = STANDARD_CAN
        CanIfTxPduDlc = 8
        CanIfTxPduUserTxConfirmationName = PduR_CanIfTxConfirmation
        CanIfTxPduUserTxConfirmationUL = PDUR
        CanIfTxPduBufferRef = CanIfInitCfg/CHNL_9e0fa25a
        CanIfTxPduRef = EcucPduCollection/BCM1_1_oN_CAN1_1aba8317_Tx
    CanIfPrivateCfg: CanIfPrivateSoftwareFilterType=LINEAR
    CanIfPublicCfg: CanIfPublicPnSupport=false
  module config CanNm
    CanNmGlobalConfig:
      CanNmBusSynchronizationEnabled = false
      CanNmPassiveModeEnabled = true
      CanNmPnEiraCalcEnabled = false
      CanNmRemoteSleepIndEnabled = false
      CanNmUserDataEnabled = true
      N_CAN1_CAN_0a431799 (CanNmChannelConfig):
        CanNmMsgReducedTime = 0.05
        CanNmNodeId = 0
        CanNmRepeatMessageTime = 0.4
        CanNmTimeoutTime = 1
        CanNmUserDataLength = 6
        CanNmWaitBusSleepTime = 0.75
        CanNmComMNetworkHandleRef = ComMConfigSet/CN_N_CAN1_3b6df477
        N_CAN1_CAN_0a431799_Rx (CanNmRxPdu)
  module config CanSM
    CanSMConfiguration
      CHNL_9e0fa25a (CanSMManagerNetwork): CanSMComMNetworkHandleRef=ComMConfigSet/CN_N_CAN1_3b6df477
        CT_N_CAN1_b4b44715 (CanSMController): CanSMControllerId=CanIfCtrlDrvCfg_7d254554/CT_N_CAN1_d616d994
  module config Com
    ComConfig
      BCM1_1_oN_CAN1_44e7d6dd_Tx (ComIPdu):
        ComIPduDirection = SEND
        ComIPduType = NORMAL
        ComIPduGroupRef = BCM_oN_CAN1_Tx_92862aa9
        ComIPduSignalRef = Sig_Light_1_Sts_oBCM1_1_oN_CAN1_e6c4aa46_Tx
        ComPduIdRef = EcucPduCollection/BCM1_1_oN_CAN1_44e7d6dd_Tx
        ComTxIPdu: ComMinimumDelayTime=0, ComTxIPduUnusedAreasDefault=0
          ComTxModeFalse
            ComTxMode: ComTxModeMode=PERIODIC, ComTxModeTimeOffset=0, ComTxModeTimePeriod=0.1
          ComTxModeTrue
            ComTxMode: ComTxModeMode=PERIODIC, ComTxModeTimeOffset=0, ComTxModeTimePeriod=0.1
      Gateway_1_oN_CAN1_a41891bf_Rx (ComIPdu):
        ComIPduDirection = RECEIVE
        ComIPduType = NORMAL
        ComIPduGroupRef = BCM_oN_CAN1_Rx_c4dc8d2f
        ComIPduSignalRef = Sig_Light_1_Ctrl_oGateway_1_oN_CAN1_1104c004_Rx
        ComPduIdRef = EcucPduCollection/Gateway_1_oN_CAN1_a41891bf_Rx
      BCM_oN_CAN1_Rx_c4dc8d2f (ComIPduGroup)
      BCM_oN_CAN1_Tx_92862aa9 (ComIPduGroup)
      Sig_Light_1_Ctrl_oGateway_1_oN_CAN1_1104c004_Rx (ComSignal):
        ComBitPosition = 7
        ComBitSize = 8
        ComSignalEndianness = BIG_ENDIAN
        ComSignalInitValue = 0
        ComSignalType = UINT8
        ComTimeout = 0
        ComSystemTemplateSystemSignalRef = Sig_Light_1_Ctrl
      Sig_Light_1_Sts_oBCM1_1_oN_CAN1_e6c4aa46_Tx (ComSignal):
        ComBitPosition = 7
        ComBitSize = 8
        ComSignalEndianness = BIG_ENDIAN
        ComSignalInitValue = 0
        ComSignalType = UINT8
        ComTransferProperty = PENDING
        ComSystemTemplateSystemSignalRef = Sig_Light_1_Sts
    ComGeneral
  module config ComM
    ComMConfigSet: ComMPncEnabled=false
      CN_N_CAN1_3b6df477 (ComMChannel): ComMBusType=COMM_BUS_TYPE_CAN, ComMChannelId=0
        ComMNetworkManagement: ComMNmVariant=PASSIVE
        CN_N_CAN1_b3186b7e (ComMUserPerChannel): ComMUserChannel=CN_N_CAN1_e2dd2bfb
      CN_N_CAN1_e2dd2bfb (ComMUser): ComMUserIdentifier=0
    ComMGeneral: ComMPncIdCounting=COMM_PNC_ID_COUNT_FROM_NM_MESSAGE, ComMPncSupport=false
  module config Dio
    CommonPublishedInformation:  # Project Standard Configuration
      ArReleaseMajorVersion = 4
      ArReleaseMinorVersion = 2
      ArReleaseRevisionVersion = 2
      ModuleId = 120
      SwMajorVersion = 1
      SwMinorVersion = 0
      SwPatchVersion = 1
      VendorId = 43
    DioConfig  # Project Standard Configuration
      DioPort_PTB (DioPort): DioPortId=1  # Project Standard Configuration
        3 x DioChannel:
          DioChannel_PTB25: DioChannelId=25  # Project Standard Configuration
          DioChannel_PTB27: DioChannelId=27  # Project Standard Configuration
          DioChannel_PTB28: DioChannelId=28  # Project Standard Configuration
      DioPort_PTE (DioPort): DioPortId=4  # Project Standard Configuration
        4 x DioChannel:
          DioChannel_PTE16: DioChannelId=16  # Project Standard Configuration
          DioChannel_PTE20: DioChannelId=20  # Project Standard Configuration
          DioChannel_PTE21: DioChannelId=21  # Project Standard Configuration
          DioChannel_PTE4: DioChannelId=4  # Project Standard Configuration
    DioGeneral:  # Project Standard Configuration
      DioDevErrorDetect = false
      DioEnableUserModeSupport = false
      DioFlipChannelApi = true
      DioMaskedWritePortApi = false
      DioReadZeroForUndefinedPortPins = false
      DioReversePortBits = false
      DioVersionInfoApi = false
  module config EcuC
    EcucPduCollection: PduIdTypeEnum=UINT8, PduLengthTypeEnum=UINT8
      4 x Pdu, all with PduLength=8:
        BCM1_1_oN_CAN1_1aba8317_Tx: SysTPduToFrameMappingRef=BCM1_1
        BCM1_1_oN_CAN1_44e7d6dd_Tx
        Gateway_1_oN_CAN1_64b0488c_Rx: SysTPduToFrameMappingRef=Gateway_1
        Gateway_1_oN_CAN1_a41891bf_Rx
  module config EcuM
    EcuMConfiguration
      EcuMCommonConfiguration
        EcuMDriverInitListOne
        EcuMDriverRestartList
        CN_N_CAN1_3b6df477 (EcuMWakeupSource): EcuMWakeupSourceId=5, EcuMComMChannelRef=ComMConfigSet/CN_N_CAN1_3b6df477
      EcuMFlexConfiguration: EcuMFlexModuleConfigurationRef=CanConfigSet
  module config Mcu
    CommonPublishedInformation:  # Project Standard Configuration
      ArReleaseMajorVersion = 4
      ArReleaseMinorVersion = 2
      ArReleaseRevisionVersion = 2
      ModuleId = 101
      SwMajorVersion = 1
      SwMinorVersion = 0
      SwPatchVersion = 1
      VendorApiInfix = 
      VendorId = 43
    McuDebugConfiguration: McuDisableCmuApi=false, McuDisableDemReportErrorStatus=false, McuEnablePeripheralCMU=false, McuGetMidrStructureApi=false, McuGetPeriphStateApi=false  # Project Standard Configuration
    McuGeneralConfiguration:  # Project Standard Configuration
      McuCalloutBeforePerformReset = false
      McuDevErrorDetect = false
      McuEnableUserModeSupport = false
      McuEnterLowPowerMode = false
      McuGetRamStateApi = false
      McuInitClock = true
      McuNoPll = false
      McuPerformResetApi = true
      McuPerformResetCallout = NULL_PTR
      McuTimeout = 50000
      McuVersionInfoApi = false
    McuModuleConfiguration:  # Project Standard Configuration
      McuClockSrcFailureNotification = ENABLED
      McuLPO1KClockEnable = true
      McuLPO32KClockEnable = true
      McuLPOClockSelect = LPO_CLK_128K
      McuNumberOfMcuModes = 1
      McuRTCCLKINFrequencyHz = 32000
      McuRamSectors = 0
      McuRtcClkSelect = SOSCDIV1_CLK
      McuAllowedModes: McuAllowHighSpeedRunMode=false, McuAllowVeryLowPowerModes=false  # Project Standard Configuration
      McuClockSettingConfig_0 (McuClockSettingConfig): McuClockSettingId=0, McuScgClkOutSelect=SCG_SLOW_CLK, McuSysClockUnderMcuControl=true  # Project Standard Configuration
        McuClkMonitor_0:  # Project Standard Configuration
          McuClkMonitorEn = false
          McuFrequencyHigherInterrupt = false
          McuFrequencyLowerInterrupt = false
          McuHighFrequencyRef = 16777215
          McuLowFrequencyRef = 0
          McuReferenceCountConfiguration = 65535
        McuClkMonitor_1:  # Project Standard Configuration
          McuClkMonitorEn = false
          McuFrequencyHigherInterrupt = false
          McuFrequencyLowerInterrupt = false
          McuHighFrequencyRef = 16777215
          McuLowFrequencyRef = 0
          McuReferenceCountConfiguration = 65535
        McuClockReferencePoint_0 (McuClockReferencePoint): McuClockFrequencySelect=RUN_SYS_CLK, McuClockReferencePointFrequency=80000000  # Project Standard Configuration
        McuFIRCClockConfig:  # Project Standard Configuration
          McuFIRCDiv1 = 1
          McuFIRCDiv1Frequency = 48000000
          McuFIRCDiv2 = 2
          McuFIRCDiv2Frequency = 24000000
          McuFIRCEnable = true
          McuFIRCFrequency = 48000000
          McuFIRCRangeSelect = TRIMMED_TO_48MHZ
          McuFIRCRegulatorEnable = false
          McuFIRCUnderMcuControl = true
        McuHsrunClockConfig:  # Project Standard Configuration
          McuBusClockDivider = 1
          McuBusClockFrequency = 48000000
          McuCoreClockDivider = 1
          McuCoreClockFrequency = 48000000
          McuFlashClockFrequency = 24000000
          McuPreDivSystemClockFrequency = 48000000
          McuScgClkOutFrequency = 24000000
          McuSlowClockDivider = 2
          McuSystemClockFrequency = 48000000
          McuSystemClockSwitch = FIRC
        41 x McuPeripheralClockConfig, all with McuPeripheralClockDivider=1, McuPeripheralClockEnable=true, McuPeripheralClockFrequency=0, McuPeripheralClockSelect=EXT_CLK_OR_CLK_OFF, McuPeripheralFractionalDivider=0:
          McuPeripheralClockConfig_0: McuPerName=FTFC  # Project Standard Configuration
          McuPeripheralClockConfig_1: McuPerName=DMAMUX0  # Project Standard Configuration
          McuPeripheralClockConfig_10: McuPerName=PDB1  # Project Standard Configuration
          McuPeripheralClockConfig_11: McuPerName=CRC  # Project Standard Configuration
          McuPeripheralClockConfig_12: McuPerName=PDB0  # Project Standard Configuration
          McuPeripheralClockConfig_13: McuPerName=LPIT  # Project Standard Configuration
          McuPeripheralClockConfig_14: McuPerName=FTM0  # Project Standard Configuration
          McuPeripheralClockConfig_15: McuPerName=FTM1  # Project Standard Configuration
          McuPeripheralClockConfig_16: McuPerName=FTM2  # Project Standard Configuration
          McuPeripheralClockConfig_17: McuPerName=ADC0  # Project Standard Configuration
          McuPeripheralClockConfig_18: McuPerName=RTC  # Project Standard Configuration
          McuPeripheralClockConfig_19: McuPerName=LPTMR0  # Project Standard Configuration
          McuPeripheralClockConfig_2: McuPerName=FLEXCAN0  # Project Standard Configuration
          McuPeripheralClockConfig_20: McuPerName=PORTA  # Project Standard Configuration
          McuPeripheralClockConfig_21: McuPerName=PORTB  # Project Standard Configuration
          McuPeripheralClockConfig_22: McuPerName=PORTC  # Project Standard Configuration
          McuPeripheralClockConfig_23: McuPerName=PORTD  # Project Standard Configuration
          McuPeripheralClockConfig_24: McuPerName=PORTE  # Project Standard Configuration
          McuPeripheralClockConfig_25: McuPerName=SAI0  # Project Standard Configuration
          McuPeripheralClockConfig_26: McuPerName=SAI1  # Project Standard Configuration
          McuPeripheralClockConfig_27: McuPerName=FLEXIO  # Project Standard Configuration
          McuPeripheralClockConfig_28: McuPerName=EWM  # Project Standard Configuration
          McuPeripheralClockConfig_29: McuPerName=LPI2C0  # Project Standard Configuration
          McuPeripheralClockConfig_3: McuPerName=FLEXCAN1  # Project Standard Configuration
          McuPeripheralClockConfig_30: McuPerName=LPI2C1  # Project Standard Configuration
          McuPeripheralClockConfig_31: McuPerName=LPUART0  # Project Standard Configuration
          McuPeripheralClockConfig_32: McuPerName=LPUART1  # Project Standard Configuration
          McuPeripheralClockConfig_33: McuPerName=LPUART2  # Project Standard Configuration
          McuPeripheralClockConfig_34: McuPerName=FTM4  # Project Standard Configuration
          McuPeripheralClockConfig_35: McuPerName=FTM5  # Project Standard Configuration
          McuPeripheralClockConfig_36: McuPerName=FTM6  # Project Standard Configuration
          McuPeripheralClockConfig_37: McuPerName=FTM7  # Project Standard Configuration
          McuPeripheralClockConfig_38: McuPerName=CMP0  # Project Standard Configuration
          McuPeripheralClockConfig_39: McuPerName=QSPI  # Project Standard Configuration
          McuPeripheralClockConfig_4: McuPerName=FTM3  # Project Standard Configuration
          McuPeripheralClockConfig_40: McuPerName=ENET  # Project Standard Configuration
          McuPeripheralClockConfig_5: McuPerName=ADC1  # Project Standard Configuration
          McuPeripheralClockConfig_6: McuPerName=FLEXCAN2  # Project Standard Configuration
          McuPeripheralClockConfig_7: McuPerName=LPSPI0  # Project Standard Configuration
          McuPeripheralClockConfig_8: McuPerName=LPSPI1  # Project Standard Configuration
          McuPeripheralClockConfig_9: McuPerName=LPSPI2  # Project Standard Configuration
        McuRunClockConfig:  # Project Standard Configuration
          McuBusClockDivider = 2
          McuBusClockFrequency = 40000000
          McuCoreClockDivider = 2
          McuCoreClockFrequency = 80000000
          McuFlashClockFrequency = 20000000
          McuPreDivSystemClockFrequency = 160000000
          McuScgClkOutFrequency = 20000000
          McuSlowClockDivider = 4
          McuSystemClockFrequency = 80000000
          McuSystemClockSwitch = SPLL
        McuSIMClockConfig:  # Project Standard Configuration
          McuClockOutDivider = 1
          McuClockOutEnable = false
          McuClockOutSelect = SCG_CLKOUT
          McuDMAClockGatingEnable = true
          McuDebugTraceDividerEnable = true
          McuEIMClockGatingEnable = true
          McuERMClockGatingEnable = true
          McuGPIOClockGatingEnable = false
          McuMPUClockGatingEnable = true
          McuMSCMClockGatingEnable = true
          McuTraceClockDivider = 1
          McuTraceClockFraction = 0
          McuTraceClockSelect = CORE_CLK
        McuSIRCClockConfig:  # Project Standard Configuration
          McuSIRCDiv1 = 1
          McuSIRCDiv1Frequency = 8000000
          McuSIRCDiv2 = 2
          McuSIRCDiv2Frequency = 4000000
          McuSIRCEnable = true
          McuSIRCFrequency = 8000000
          McuSIRCLowPowerEnable = false
          McuSIRCRangeSelect = HIGH_RANGE_CLOCK
          McuSIRCStopEnable = false
          McuSIRCUnderMcuControl = true
        McuSystemOSCClockConfig:  # Project Standard Configuration
          McuSOSCClockMonitorEnable = false
          McuSOSCClockMonitorResetEnable = false
          McuSOSCDiv1 = 1
          McuSOSCDiv1Frequency = 8000000
          McuSOSCDiv2 = 2
          McuSOSCDiv2Frequency = 4000000
          McuSOSCEnable = true
          McuSOSCExternalReferenceSelect = false
          McuSOSCFrequency = 8000000
          McuSOSCHighGainOscillatorSelect = false
          McuSOSCRangeSelect = HIGH_FREQ_RANGE
          McuSOSCUnderMcuControl = true
        McuSystemPll:  # Project Standard Configuration
          McuSPLLClockMonitorEnable = false
          McuSPLLClockMonitorResetEnable = false
          McuSPLLDiv1 = 4
          McuSPLLDiv1Frequency = 40000000
          McuSPLLDiv2 = 4
          McuSPLLDiv2Frequency = 40000000
          McuSPLLEnable = true
          McuSPLLFrequency = 160000000
          McuSPLLInputClkPreDivider = 1
          McuSPLLInputFrequency = 8000000
          McuSPLLMultiplier = 40
          McuSystemPllUnderMcuControl = true
        McuVlprClockConfig:  # Project Standard Configuration
          McuBusClockDivider = 1
          McuBusClockFrequency = 4000000
          McuCoreClockDivider = 2
          McuCoreClockFrequency = 4000000
          McuFlashClockFrequency = 1000000
          McuPreDivSystemClockFrequency = 8000000
          McuScgClkOutFrequency = 1000000
          McuSlowClockDivider = 4
          McuSystemClockFrequency = 4000000
          McuSystemClockSwitch = SIRC
      McuInterruptEvents: McuAlternateResetEvent=false, McuVoltageErrorEvent=false  # Project Standard Configuration
      McuModeSettingConf_0 (McuModeSettingConf): McuMode=0, McuPowerMode=RUN  # Project Standard Configuration
      McuPowerControl:  # Project Standard Configuration
        McuClockBiasDisable = false
        McuLPODisable = false
        McuLowPowerBiasEnable = false
        McuLowVoltageDetectInterruptEnable = false
        McuLowVoltageDetectResetEnable = false
        McuLowVoltageWarningInterruptEnable = false
        McuLpoTrimming = 0
      McuResetConfig: McuResetPinFilterBusClockSelect=0, McuResetPinFilterInRunAndWait=ALL_FILTERING_DISABLE, McuResetPinFilterInStopMode=ALL_FILTERING_DISABLE  # Project Standard Configuration
        McuSystemInterruptEnable:  # Project Standard Configuration
          McuCMULossOfClockResetInterrupt = false
          McuCoreLockupInterrupt = false
          McuExternalResetPinInterrupt = false
          McuGlobalInterrupt = false
          McuJTAGResetInterrupt = false
          McuLossOfClockInterrupt = false
          McuLossOfLockInterrupt = false
          McuMDMAPSystemResetInterrupt = false
          McuResetDelayTime = DELAY_10_LPO_CYCLES
          McuSoftwareInterrupt = false
          McuStopAcknowledgeErrorInterrupt = false
          McuWatchdogInterrupt = false
      McuSIMConfig  # Project Standard Configuration
        McuAdcOptionsConfiguration:  # Project Standard Configuration
          McuADC0PreTrigeerSourceSelect = PDB_PRE_TRIGGER
          McuADC0SoftwarePreTrigeerSourceSelect = SW_PRE_TRIGGER_DISABLE
          McuADC0TrigeerSourceSelect = PDB
          McuADC1PreTrigeerSourceSelect = PDB_PRE_TRIGGER
          McuADC1SoftwarePreTrigeerSourceSelect = SW_PRE_TRIGGER_DISABLE
          McuADC1TrigeerSourceSelect = PDB
          McuSoftwareTriggerToTRGMUX = false
        McuChipControlConfiguration:  # Project Standard Configuration
          McuAdcSupply = VDD
          McuEnableAdcSupplyMonitoring = false
          McuPDBBackToBackSelect = false
          McuPTB0InterleaveChannelSelect = false
          McuPTB13InterleaveChannelSelect = false
          McuPTB14InterleaveChannelSelect = false
          McuPTB1InterleaveChannelSelect = false
        McuFlexTimerConfiguration:  # Project Standard Configuration
          McuFTM0Ch{0..7}ModulationSelect = false
          McuFTM0ExternalClockPinSelect = TCLK0_PIN
          McuFTM0Fault{0..2}Select = FTM0_FLT{0..2}_PIN
          McuFTM0OBEControl = false
          McuFTM0SyncBit = false
          McuFTM1Ch0InputSelect = FTM1_CH0_INPUT
          McuFTM1ExternalClockPinSelect = TCLK0_PIN
          McuFTM1Fault{0..2}Select = FTM1_FLT{0..2}_PIN
          McuFTM1OBEControl = false
          McuFTM1SyncBit = false
          McuFTM2Ch0InputSelect = FTM2_CH0_INPUT
          McuFTM2Ch1InputSelect = FTM2_CHI1_INPUT
          McuFTM2ExternalClockPinSelect = TCLK0_PIN
          McuFTM2Fault{0..2}Select = FTM2_FLT{0..2}_PIN
          McuFTM2OBEControl = false
          McuFTM2SyncBit = false
          McuFTM3Ch{0..7}ModulationSelect = false
          McuFTM3ExternalClockPinSelect = TCLK0_PIN
          McuFTM3Fault{0..2}Select = FTM3_FLT{0..2}_PIN
          McuFTM3OBEControl = false
          McuFTM3SyncBit = false
          McuFTM4ExternalClockPinSelect = TCLK0_PIN
          McuFTM4OBEControl = false
          McuFTM4SyncBit = false
          McuFTM5ExternalClockPinSelect = TCLK0_PIN
          McuFTM5OBEControl = false
          McuFTM5SyncBit = false
          McuFTM6ExternalClockPinSelect = TCLK0_PIN
          McuFTM6OBEControl = false
          McuFTM6SyncBit = false
          McuFTM7ExternalClockPinSelect = TCLK0_PIN
          McuFTM7OBEControl = false
          McuFTM7SyncBit = false
          McuFTMGlobalLoadEnable = false
          McuFTM_GTBControl = false
          McuQspiClkSelect = false
          McuRMII_ClkSelect = false
          McuRMII_Clk_OBE = false
    McuPublishedInformation  # Project Standard Configuration
      15 x McuResetReasonConf:
        MCU_CMU_LOC_RESET: McuResetReason=14  # Project Standard Configuration
        MCU_CORE_LOCKUP_RESET: McuResetReason=3  # Project Standard Configuration
        MCU_EXTERNAL_PIN_RESET: McuResetReason=6  # Project Standard Configuration
        MCU_JTAG_RESET: McuResetReason=4  # Project Standard Configuration
        MCU_LOSS_OF_CLOCK_RESET: McuResetReason=9  # Project Standard Configuration
        MCU_LOSS_OF_LOCK_RESET: McuResetReason=8  # Project Standard Configuration
        MCU_LOW_OR_HIGH_VOLTAGE_DETECT_RESET: McuResetReason=10  # Project Standard Configuration
        MCU_MDM_AP_SYSTEM_RESET: McuResetReason=1  # Project Standard Configuration
        MCU_MULTIPLE_RESET_REASON: McuResetReason=12  # Project Standard Configuration
        MCU_NO_RESET_REASON: McuResetReason=11  # Project Standard Configuration
        MCU_POWER_ON_RESET: McuResetReason=5  # Project Standard Configuration
        MCU_RESET_UNDEFINED: McuResetReason=13  # Project Standard Configuration
        MCU_STOP_ACKNOWLEDGE_ERROR_RESET: McuResetReason=0  # Project Standard Configuration
        MCU_SW_RESET: McuResetReason=2  # Project Standard Configuration
        MCU_WATCHDOG_RESET: McuResetReason=7  # Project Standard Configuration
  module config Nm
    CN_N_CAN1_3b6df477 (NmChannelConfig): NmPassiveModeEnabled=true, NmComMChannelRef=ComMConfigSet/CN_N_CAN1_3b6df477
      N_CAN1_CAN_0a431799 (NmBusType)
        NmStandardBusNmConfig: NmStandardBusType=NM_BUSNM_CANNM  # N_CAN1_CAN
    NmGlobalConfig
      NmGlobalFeatures: NmBusSynchronizationEnabled=false, NmNodeIdEnabled=true, NmUserDataEnabled=true
      NmGlobalProperties
  module config PduR
    PduRGeneral
    PduRRoutingTables
      PduRRoutingTable
        BCM1_1_oN_CAN1_44e7d6dd_Tx (PduRRoutingPath)
          BCM1_1_oN_CAN1_1aba8317_Tx (PduRDestPdu): PduRDestPduRef=EcucPduCollection/BCM1_1_oN_CAN1_1aba8317_Tx
          PduRSrcPdu_14488284 (PduRSrcPdu): PduRSrcPduRef=EcucPduCollection/BCM1_1_oN_CAN1_44e7d6dd_Tx
        Gateway_1_oN_CAN1_64b0488c_Rx (PduRRoutingPath)
          Gateway_1_oN_CAN1_64b0488c_Rx_5c8e2856_Rx (PduRDestPdu): PduRDestPduRef=EcucPduCollection/Gateway_1_oN_CAN1_a41891bf_Rx
          PduRSrcPdu_5c8e2856 (PduRSrcPdu): PduRSrcPduRef=EcucPduCollection/Gateway_1_oN_CAN1_64b0488c_Rx
  module config Port
    CommonPublishedInformation:  # Project Standard Configuration
      ArReleaseMajorVersion = 4
      ArReleaseMinorVersion = 2
      ArReleaseRevisionVersion = 2
      ModuleId = 124
      SwMajorVersion = 1
      SwMinorVersion = 0
      SwPatchVersion = 1
      VendorId = 43
    PortConfigSet  # Project Standard Configuration
      NotUsedPortPin: PortPinDSE=Low_Drive_Strength, PortPinDirection=PORT_PIN_IN, PortPinLevelValue=PORT_PIN_LEVEL_LOW, PortPinPE=PullDisabled, PortPinPS=PullDown  # Project Standard Configuration
      4 x PortContainer:
        PTA: PortNumberOfPortPins=3  # Project Standard Configuration
          3 x PortPin, all with PortPinDSE=Low_drive_strength, PortPinDirectionChangeable=true, PortPinInitialMode=PORT_GPIO_MODE, PortPinLevelValue=PORT_PIN_LEVEL_LOW, PortPinModeChangeable=true, PortPinPE=PullDisabled, PortPinPFE=false, PortPinPS=PullDown:
            PortPin_PTA10_JATGTDO: PortPinDirection=PORT_PIN_OUT, PortPinId=6, PortPinMode=JTAG_TDO, PortPinPcr=10  # Project Standard Configuration
            PortPin_PTA4_SWDDIO: PortPinDirection=PORT_PIN_OUT, PortPinId=3, PortPinMode=JTAG_TMS_SWD_DIO, PortPinPcr=4  # Project Standard Configuration
            PortPin_PTA5_RESET: PortPinDirection=PORT_PIN_IN, PortPinId=7, PortPinMode=RESET_b, PortPinPcr=5  # Project Standard Configuration
        PTB: PortNumberOfPortPins=3  # Project Standard Configuration
          3 x PortPin, all with PortPinDSE=Low_drive_strength, PortPinDirectionChangeable=true, PortPinInitialMode=PORT_GPIO_MODE, PortPinLevelValue=PORT_PIN_LEVEL_LOW, PortPinMode=GPIO, PortPinModeChangeable=true, PortPinPFE=false:
            PortPin_PTB25_CAN0_ERR: PortPinDirection=PORT_PIN_IN, PortPinId=10, PortPinPE=PullEnabled, PortPinPS=PullUp, PortPinPcr=57  # Project Standard Configuration
            PortPin_PTB27_CAN0_EN: PortPinDirection=PORT_PIN_OUT, PortPinId=11, PortPinPE=PullDisabled, PortPinPS=PullDown, PortPinPcr=59  # Project Standard Configuration
            PortPin_PTB28_CAN0_STB: PortPinDirection=PORT_PIN_OUT, PortPinId=12, PortPinPE=PullDisabled, PortPinPS=PullDown, PortPinPcr=60  # Project Standard Configuration
        PTC: PortNumberOfPortPins=2  # Project Standard Configuration
          PortPin_PTC4_SWDCLK (PortPin):  # Project Standard Configuration
            PortPinDSE = Low_drive_strength
            PortPinDirection = PORT_PIN_IN
            PortPinDirectionChangeable = true
            PortPinId = 4
            PortPinInitialMode = PORT_GPIO_MODE
            PortPinLevelValue = PORT_PIN_LEVEL_LOW
            PortPinMode = JTAG_TCLK_SWD_CLK
            PortPinModeChangeable = true
            PortPinPE = PullDisabled
            PortPinPFE = false
            PortPinPS = PullDown
            PortPinPcr = 68
          PortPin_PTC5_JATGTDI (PortPin):  # Project Standard Configuration
            PortPinDSE = Low_drive_strength
            PortPinDirection = PORT_PIN_IN
            PortPinDirectionChangeable = true
            PortPinId = 5
            PortPinInitialMode = PORT_GPIO_MODE
            PortPinLevelValue = PORT_PIN_LEVEL_LOW
            PortPinMode = JTAG_TDI
            PortPinModeChangeable = true
            PortPinPE = PullDisabled
            PortPinPFE = false
            PortPinPS = PullDown
            PortPinPcr = 69
        PTE: PortNumberOfPortPins=5  # Project Standard Configuration
          5 x PortPin, all with PortPinDSE=Low_drive_strength, PortPinDirectionChangeable=true, PortPinInitialMode=PORT_GPIO_MODE, PortPinLevelValue=PORT_PIN_LEVEL_LOW, PortPinModeChangeable=true, PortPinPE=PullDisabled, PortPinPFE=false, PortPinPS=PullDown:
            PortPin_PTE16: PortPinDirection=PORT_PIN_IN, PortPinId=13, PortPinMode=GPIO, PortPinPcr=144  # Project Standard Configuration
            PortPin_PTE20: PortPinDirection=PORT_PIN_OUT, PortPinId=1, PortPinMode=GPIO, PortPinPcr=148  # Project Standard Configuration
            PortPin_PTE21: PortPinDirection=PORT_PIN_OUT, PortPinId=2, PortPinMode=GPIO, PortPinPcr=149  # Project Standard Configuration
            PortPin_PTE4_CAN0_RX: PortPinDirection=PORT_PIN_IN, PortPinId=8, PortPinMode=CAN0_RX, PortPinPcr=132  # Project Standard Configuration
            PortPin_PTE5_CAN0_TX: PortPinDirection=PORT_PIN_OUT, PortPinId=9, PortPinMode=CAN0_TX, PortPinPcr=133  # Project Standard Configuration
    PortGeneral:  # Project Standard Configuration
      PortDevErrorDetect = true
      PortEnableUserModeSupport = false
      PortSet2PinsDirectionApi = false
      PortSetPinDirectionApi = true
      PortSetPinModeApi = true
      PortSetPinModeDoesNotTouchGpioLevel = false
      PortVersionInfoApi = true
  module config Resource
    CommonPublishedInformation:  # Project Standard Configuration
      ArReleaseMajorVersion = 4
      ArReleaseMinorVersion = 2
      ArReleaseRevisionVersion = 2
      ModuleId = 0
      SwMajorVersion = 1
      SwMinorVersion = 0
      SwPatchVersion = 1
      VendorId = 43
    ResourceGeneral: ResourceSubderivative=s32k148_lqfp144  # Project Standard Configuration
