AUTOSAR XML (schema 4-2-1)
package /ActiveEcuC
  module config Port: implementation-config-variant=VARIANT-POST-BUILD, module-description=Port_Impl
    PortConfigSet
      PTA (PortContainer): PortNumberOfPortPins=3
        3 x PortPin, all with PortPinDSE=Low_drive_strength, PortPinDirectionChangeable=true, PortPinInitialMode=PORT_GPIO_MODE, PortPinLevelValue=PORT_PIN_LEVEL_LOW, PortPinModeChangeable=true, PortPinPE=PullDisabled, PortPinPFE=false, PortPinPS=PullDown:
          PortPin_PTA4_SWDDIO: PortPinDirection=PORT_PIN_OUT, PortPinId=3, PortPinMode=JTAG_TMS_SWD_DIO, PortPinPcr=4
          PortPin_PTA5_RESET: PortPinDirection=PORT_PIN_IN, PortPinId=7, PortPinMode=RESET_b, PortPinPcr=5
          PortPin_PTA10_JATGTDO: PortPinDirection=PORT_PIN_OUT, PortPinId=6, PortPinMode=JTAG_TDO, PortPinPcr=10
      PTC (PortContainer): PortNumberOfPortPins=2
        PortPin_PTC4_SWDCLK (PortPin):
          PortPinDSE = Low_drive_strength
          PortPinDirection = PORT_PIN_IN
          PortPinDirectionChangeable = true
          PortPinId = 4
          PortPinInitialMode = PORT_GPIO_MODE
          PortPinLevelValue = PORT_PIN_LEVEL_LOW
          PortPinMode = JTAG_TCLK_SWD_CLK
          PortPinModeChangeable = true
          PortPinPE = PullDisabled
          PortPinPFE = false
          PortPinPS = PullDown
          PortPinPcr = 68
        PortPin_PTC5_JATGTDI (PortPin):
          PortPinDSE = Low_drive_strength
          PortPinDirection = PORT_PIN_IN
          PortPinDirectionChangeable = true
          PortPinId = 5
          PortPinInitialMode = PORT_GPIO_MODE
          PortPinLevelValue = PORT_PIN_LEVEL_LOW
          PortPinMode = JTAG_TDI
          PortPinModeChangeable = true
          PortPinPE = PullDisabled
          PortPinPFE = false
          PortPinPS = PullDown
          PortPinPcr = 69
      NotUsedPortPin: PortPinDSE=Low_Drive_Strength, PortPinDirection=PORT_PIN_IN, PortPinLevelValue=PORT_PIN_LEVEL_LOW, PortPinPE=PullDisabled, PortPinPS=PullDown
      PTE (PortContainer): PortNumberOfPortPins=2
        PortPin_PTE20 (PortPin):
          PortPinDSE = Low_drive_strength
          PortPinDirection = PORT_PIN_OUT
          PortPinDirectionChangeable = true
          PortPinId = 1
          PortPinInitialMode = PORT_GPIO_MODE
          PortPinLevelValue = PORT_PIN_LEVEL_LOW
          PortPinMode = GPIO
          PortPinModeChangeable = true
          PortPinPE = PullDisabled
          PortPinPFE = false
          PortPinPS = PullDown
          PortPinPcr = 148
        PortPin_PTE21 (PortPin):
          PortPinDSE = Low_drive_strength
          PortPinDirection = PORT_PIN_OUT
          PortPinDirectionChangeable = true
          PortPinId = 2
          PortPinInitialMode = PORT_GPIO_MODE
          PortPinLevelValue = PORT_PIN_LEVEL_LOW
          PortPinMode = GPIO
          PortPinModeChangeable = true
          PortPinPE = PullDisabled
          PortPinPFE = false
          PortPinPS = PullDown
          PortPinPcr = 149
    PortGeneral:
      PortDevErrorDetect = true
      PortEnableUserModeSupport = false
      PortSet2PinsDirectionApi = false
      PortSetPinDirectionApi = true
      PortSetPinModeApi = true
      PortSetPinModeDoesNotTouchGpioLevel = false
      PortVersionInfoApi = true
    CommonPublishedInformation:
      ArReleaseMajorVersion = 4
      ArReleaseMinorVersion = 2
      ArReleaseRevisionVersion = 2
      ModuleId = 124
      SwMajorVersion = 1
      SwMinorVersion = 0
      SwPatchVersion = 1
      VendorId = 43
