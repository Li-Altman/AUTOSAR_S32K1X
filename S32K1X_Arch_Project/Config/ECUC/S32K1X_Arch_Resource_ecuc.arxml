AUTOSAR XML (schema 4-2-1)
package /ActiveEcuC
  module config Resource: implementation-config-variant=VARIANT-PRE-COMPILE
    ResourceGeneral: ResourceSubderivative=s32k148_lqfp144
    CommonPublishedInformation:
      ArReleaseMajorVersion = 4
      ArReleaseMinorVersion = 2
      ArReleaseRevisionVersion = 2
      ModuleId = 0
      SwMajorVersion = 1
      SwMinorVersion = 0
      SwPatchVersion = 1
      VendorId = 43
