AUTOSAR XML (schema 4-2-1)
package /ActiveEcuC
  module config EcuM: implementation-config-variant=VARIANT-PRE-COMPILE, module-description=EcuM_Impl
    EcuMConfiguration
      EcuMFlexConfiguration: EcuMFlexModuleConfigurationRef=CanConfigSet, EcuMNormalMcuModeRef=McuModeSettingConf_0
        ECUM_CAUSE_UNKNOWN (EcuMShutdownCause): EcuMShutdownCauseId=0
        ECUM_RESET_IO (EcuMResetMode): EcuMResetModeId=2
        ECUM_RESET_MCU (EcuMResetMode): EcuMResetModeId=0
        ECUM_CAUSE_DCM (EcuMShutdownCause): EcuMShutdownCauseId=3
        ECUM_RESET_WAKEUP (EcuMResetMode): EcuMResetModeId=3
        ECUM_CAUSE_ECU_STATE (EcuMShutdownCause): EcuMShutdownCauseId=1
        ECUM_RESET_WDG (EcuMResetMode): EcuMResetModeId=1
        ECUM_CAUSE_WDGM (EcuMShutdownCause): EcuMShutdownCauseId=2
      EcuMCommonConfiguration: EcuMConfigConsistencyHash=17466080998731166732, EcuMDefaultAppMode=OSDEFAULTAPPMODE, EcuMOSResource=OsResource
        CN_N_CAN1_3b6df477 (EcuMWakeupSource): EcuMWakeupSourceId=5, EcuMWakeupSourcePolling=false, EcuMComMChannelRef=CN_N_CAN1_3b6df477
        ECUM_WKSOURCE_POWER (EcuMWakeupSource): EcuMWakeupSourceId=0, EcuMValidationTimeout=0, EcuMCheckWakeupTimeout=0, EcuMWakeupSourcePolling=false
        EcuMDriverInitListOne
          3 x EcuMDriverInitItem:
            Mcu_Init: index=0, EcuMModuleID=Mcu, EcuMModuleService=Mcu_Init, EcuMModuleHeader=Mcu.h
            Mcu_Init_AdditionalCode: index=1, EcuMModuleID=Code, EcuMAdditionalInitCode=Mcu_InitClock(McuConf_McuClockSettingConfig_McuClockSettingConfig_0); while (MCU_PLL_LOCKED != Mcu_GetPllStatus()); Mcu_DistributePllClock();, EcuMModuleHeader=Mcu.h
            Port_Init: index=1, EcuMModuleID=Port, EcuMModuleService=Port_Init, EcuMModuleHeader=Port.h
        3 x EcuMWakeupSource, all with EcuMValidationTimeout=0, EcuMCheckWakeupTimeout=0, EcuMWakeupSourcePolling=false:
          ECUM_WKSOURCE_INTERNAL_WDG: EcuMWakeupSourceId=3
          ECUM_WKSOURCE_INTERNAL_RESET: EcuMWakeupSourceId=2
          ECUM_WKSOURCE_RESET: EcuMWakeupSourceId=1
        EcuMDefaultShutdownTarget: EcuMDefaultState=EcuMStateOff
        EcuMDriverRestartList
        ECUM_WKSOURCE_EXTERNAL_WDG (EcuMWakeupSource): EcuMWakeupSourceId=4, EcuMValidationTimeout=0, EcuMCheckWakeupTimeout=0, EcuMWakeupSourcePolling=false
        EcuMDriverInitListZero
          11 x EcuMDriverInitItem:
            BswM_InitMemory: index=0, EcuMModuleID=BswM, EcuMModuleService=BswM_InitMemory, EcuMModuleHeader=BswM.h
            CanIf_InitMemory: index=1, EcuMModuleID=CanIf, EcuMModuleService=CanIf_InitMemory, EcuMModuleHeader=CanIf.h
            CanSM_InitMemory: index=2, EcuMModuleID=CanSM, EcuMModuleService=CanSM_InitMemory, EcuMModuleHeader=CanSM_EcuM.h
            Can_InitMemory: index=3, EcuMModuleID=Can, EcuMModuleService=Can_InitMemory, EcuMModuleHeader=Can.h
            ComM_InitMemory: index=4, EcuMModuleID=ComM, EcuMModuleService=ComM_InitMemory, EcuMModuleHeader=ComM.h
            Com_InitMemory: index=5, EcuMModuleID=Com, EcuMModuleService=Com_InitMemory, EcuMModuleHeader=Com.h
            Det_Init: index=6, EcuMModuleID=Det, EcuMModuleService=Det_Init, EcuMModuleHeader=Det.h
            Det_InitMemory: index=7, EcuMModuleID=Det, EcuMModuleService=Det_InitMemory, EcuMModuleHeader=Det.h
            PduR_InitMemory: index=8, EcuMModuleID=PduR, EcuMModuleService=PduR_InitMemory, EcuMModuleHeader=PduR.h
            Rte_InitMemory: index=9, EcuMModuleID=Rte, EcuMModuleService=Rte_InitMemory, EcuMModuleHeader=Rte_Main.h
            CanTrcv_30_Tja1043_InitMemory: index=10, EcuMModuleID=CanTrcv, EcuMModuleService=CanTrcv_30_Tja1043_InitMemory, EcuMModuleHeader=CanTrcv_30_Tja1043.h
    EcuMGeneral:
      EcuMDevErrorDetect = true
      EcuMIncludeDem = true
      EcuMIncludeDet = true
      EcuMMainFunctionPeriod = 0.01
      EcuMVersionInfoApi = false
      EcuMDeferredBswMNotification = false
      EcuMSlaveCoreHandling = true
      EcuMEnableFixBehavior = false
      EcuMNonChannelWakeupInRun = false
      EcuMGeneration: EcuMOutOfBoundsWriteSanitizer=false, EcuMOutOfBoundsReadSanitizer=false, EcuMInterfacesForDeactivatedData=false
    EcuMFlexGeneral: EcuMAlarmClockPresent=false, EcuMResetLoopDetection=false, EcuMEnableDefBehaviour=false
