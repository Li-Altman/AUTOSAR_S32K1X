AUTOSAR XML (schema 4-2-1)
package /ActiveEcuC
  module config Dio: implementation-config-variant=VARIANT-PRE-COMPILE, module-description=Dio_Impl
    CommonPublishedInformation:
      ArReleaseMajorVersion = 4
      ArReleaseMinorVersion = 2
      ArReleaseRevisionVersion = 2
      ModuleId = 120
      SwMajorVersion = 1
      SwMinorVersion = 0
      SwPatchVersion = 1
      VendorId = 43
    DioConfig
      DioPort_PTE (DioPort): DioPortId=4
        4 x DioChannel:
          DioChannel_PTE21: DioChannelId=21
          DioChannel_PTE20: DioChannelId=20
          DioChannel_PTE16: DioChannelId=16
          DioChannel_PTE4: DioChannelId=4
      DioPort_PTB (DioPort): DioPortId=1
        3 x DioChannel:
          DioChannel_PTB28: DioChannelId=28
          DioChannel_PTB27: DioChannelId=27
          DioChannel_PTB25: DioChannelId=25
    DioGeneral:
      DioDevErrorDetect = false
      DioEnableUserModeSupport = false
      DioFlipChannelApi = true
      DioMaskedWritePortApi = false
      DioReadZeroForUndefinedPortPins = false
      DioReversePortBits = false
      DioVersionInfoApi = false
