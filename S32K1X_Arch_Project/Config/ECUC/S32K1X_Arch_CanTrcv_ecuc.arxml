AUTOSAR XML (schema 4-2-1)
package /ActiveEcuC
  module config CanTrcv: implementation-config-variant=VARIANT-PRE-COMPILE, module-description=CanTrcv_Impl
    CanTrcvConfigSet
      CanTrcvChannel:
        CanTrcvHwPnSupport = false
        CanTrcvInitState = CANTRCV_OP_MODE_NORMAL
        CanTrcvChannelId = 0
        CanTrcvChannelUsed = true
        CanTrcvControlsPowerSupply = false
        CanTrcvMaxBaudrate = 1000
        CanTrcvWakeupByBusUsed = true
        CanTrcvHardwareVariantGroup = TJA1043_REFERENCE_GROUP
        CanTrcvWakeupSourceRef = CN_N_CAN1_3b6df477
        CanTrcvAccess
          CanTrcvDioAccess
            4 x CanTrcvDioChannelAccess:
              PinEN: CanTrcvHardwareInterfaceName=PinEN, CanTrcvDioSymNameRef=DioChannel_PTB27
              PinSTB: CanTrcvHardwareInterfaceName=PinSTB, CanTrcvDioSymNameRef=DioChannel_PTB28
              PinERR: CanTrcvHardwareInterfaceName=PinERR, CanTrcvDioSymNameRef=DioChannel_PTB25
              PinRXD: CanTrcvHardwareInterfaceName=PinRXD, CanTrcvDioSymNameRef=DioChannel_PTE4
    CanTrcvGeneral:
      CanTrcvDevErrorDetect = false
      CanTrcvGetVersionInfo = false
      CanTrcvWakeUpSupport = CANTRCV_WAKEUP_BY_POLLING
      CanTrcvIndex = 0
      CanTrcvMainFunctionPeriod = 0.01
      CanTrcvSafeBswChecks = false
