AUTOSAR XML (schema 4-0-3)
package /DaVinci_Project
  module config Rte
    12 x RteBswModuleInstance:
      BswM
      Can
        3 x RteBswEventToTaskMapping, all with RteBswUsedOsEventRef=Rte_Ev_Cyclic2_RunTask_OsCore0_0_10ms, RteBswUsedOsAlarmRef=Os/Rte_Al_TE2_RunTask_OsCore0_0_10ms:
          Can_MainFunction_BusOffTimingEvent0
          Can_MainFunction_ModeTimingEvent0
          Can_MainFunction_WakeupTimingEvent0
      CanIf
      CanSM
        CanSM_MainFunctionTimingEvent0 (RteBswEventToTaskMapping): RteBswUsedOsEventRef=Rte_Ev_Cyclic2_RunTask_OsCore0_0_10ms, RteBswUsedOsAlarmRef=Os/Rte_Al_TE2_RunTask_OsCore0_0_10ms
      Com
        Com_MainFunctionRxTimingEvent0 (RteBswEventToTaskMapping): RteBswUsedOsEventRef=Rte_Ev_Cyclic2_RunTask_OsCore0_0_10ms, RteBswUsedOsAlarmRef=Os/Rte_Al_TE2_RunTask_OsCore0_0_10ms
        Com_MainFunctionTxTimingEvent0 (RteBswEventToTaskMapping): RteBswUsedOsEventRef=Rte_Ev_Cyclic2_RunTask_OsCore0_0_10ms, RteBswUsedOsAlarmRef=Os/Rte_Al_TE2_RunTask_OsCore0_0_10ms
      ComM
        ComM_MainFunction_0TimingEvent0 (RteBswEventToTaskMapping): RteBswUsedOsEventRef=Rte_Ev_Cyclic2_RunTask_OsCore0_0_20ms, RteBswUsedOsAlarmRef=Os/Rte_Al_TE2_RunTask_OsCore0_0_20ms
      Det
      Dio
      EcuM
        EcuM_MainFunctionTimingEvent0 (RteBswEventToTaskMapping): RteBswUsedOsEventRef=Rte_Ev_Cyclic2_RunTask_OsCore0_0_10ms, RteBswUsedOsAlarmRef=Os/Rte_Al_TE2_RunTask_OsCore0_0_10ms
      Mcu
      PduR
      Port
    5 x RteSwComponentInstance:
      BswM_EcuSwComposition
      ComM_EcuSwComposition
        Timer_ComM_MainFunction_0 (RteEventToTaskMapping): RteUsedOsEventRef=Rte_Ev_Cyclic2_RunTask_OsCore0_0_20ms, RteUsedOsAlarmRef=Os/Rte_Al_TE2_RunTask_OsCore0_0_20ms
      Det_EcuSwComposition
      EcuM_EcuSwComposition
        Timer_EcuM_MainFunction (RteEventToTaskMapping): RteUsedOsEventRef=Rte_Ev_Cyclic2_RunTask_OsCore0_0_10ms, RteUsedOsAlarmRef=Os/Rte_Al_TE2_RunTask_OsCore0_0_10ms
      Os_OsCore0_swc_EcuSwComposition
    RteOsInteraction
      Rte_Al_TE2_RunTask_OsCore0_0_10ms (RteUsedOsActivation): RteExpectedActivationOffset=0, RteActivationOsAlarmRef=Os/Rte_Al_TE2_RunTask_OsCore0_0_10ms, RteActivationOsTaskRef=RunTask_OsCore0
      Rte_Al_TE2_RunTask_OsCore0_0_20ms (RteUsedOsActivation): RteExpectedActivationOffset=0, RteActivationOsAlarmRef=Os/Rte_Al_TE2_RunTask_OsCore0_0_20ms, RteActivationOsTaskRef=RunTask_OsCore0
  module config NvM
  module config Os
    RunTask_OsCore0 (OsTask):
      OsTaskActivation = 1
      OsTaskPriority = 20
      OsTaskSchedule = FULL
      OsTaskEventRef = Rte_Ev_Cyclic2_RunTask_OsCore0_0_10ms
      OsTaskEventRef = Rte_Ev_Cyclic2_RunTask_OsCore0_0_20ms
    Rte_Al_TE2_RunTask_OsCore0_0_10ms (OsAlarm): OsAlarmCounterRef=OsCounter
      OsAlarmAction
        OsAlarmSetEvent: OsAlarmSetEventRef=Rte_Ev_Cyclic2_RunTask_OsCore0_0_10ms, OsAlarmSetEventTaskRef=RunTask_OsCore0
    Rte_Al_TE2_RunTask_OsCore0_0_20ms (OsAlarm): OsAlarmCounterRef=OsCounter
      OsAlarmAction
        OsAlarmSetEvent: OsAlarmSetEventRef=Rte_Ev_Cyclic2_RunTask_OsCore0_0_20ms, OsAlarmSetEventTaskRef=RunTask_OsCore0
    Rte_Ev_Cyclic2_RunTask_OsCore0_0_10ms (OsEvent)
    Rte_Ev_Cyclic2_RunTask_OsCore0_0_20ms (OsEvent)
  module config EcuC
  ecuc value collection DaVinci_Project: ecuc-values=[Com, Rte, Os, EcuC, NvM]
