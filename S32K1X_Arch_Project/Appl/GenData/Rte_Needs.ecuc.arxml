AUTOSAR XML (schema 4-0-3)
package /DaVinci_Project
  module config Com
    ComConfig
      Sig_Light_1_Ctrl_oGateway_1_oN_CAN1_1104c004_Rx (ComSignal): ComSignalType=UINT8
      Sig_Light_1_Sts_oBCM1_1_oN_CAN1_e6c4aa46_Tx (ComSignal): ComSignalType=UINT8
  module config Rte
    13 x RteBswModuleInstance:
      BswM
      Can
        3 x RteBswEventToTaskMapping, all with RteBswUsedOsEventRef=Rte_Ev_Cyclic2_RunTask_OsCore0_0_10ms, RteBswUsedOsAlarmRef=Os/Rte_Al_TE2_RunTask_OsCore0_0_10ms:
          Can_MainFunction_BusOffTimingEvent0
          Can_MainFunction_ModeTimingEvent0
          Can_MainFunction_WakeupTimingEvent0
      CanIf
      CanSM
        CanSM_MainFunctionTimingEvent0 (RteBswEventToTaskMapping): RteBswUsedOsEventRef=Rte_Ev_Cyclic2_RunTask_OsCore0_0_10ms, RteBswUsedOsAlarmRef=Os/Rte_Al_TE2_RunTask_OsCore0_0_10ms
      CanTrcv
        CanTrcv_30_Tja1043_MainFunctionTimingEvent0 (RteBswEventToTaskMapping): RteBswUsedOsEventRef=Rte_Ev_Cyclic2_RunTask_OsCore0_0_10ms, RteBswUsedOsAlarmRef=Os/Rte_Al_TE2_RunTask_OsCore0_0_10ms
      Com
        Com_MainFunctionRxTimingEvent0 (RteBswEventToTaskMapping): RteBswUsedOsEventRef=Rte_Ev_Cyclic2_RunTask_OsCore0_0_10ms, RteBswUsedOsAlarmRef=Os/Rte_Al_TE2_RunTask_OsCore0_0_10ms
        Com_MainFunctionTxTimingEvent0 (RteBswEventToTaskMapping): RteBswUsedOsEventRef=Rte_Ev_Cyclic2_RunTask_OsCore0_0_10ms, RteBswUsedOsAlarmRef=Os/Rte_Al_TE2_RunTask_OsCore0_0_10ms
      ComM
        ComM_MainFunction_0TimingEvent0 (RteBswEventToTaskMapping): RteBswUsedOsEventRef=Rte_Ev_Cyclic2_RunTask_OsCore0_0_20ms, RteBswUsedOsAlarmRef=Os/Rte_Al_TE2_RunTask_OsCore0_0_20ms
      Det
      Dio
      EcuM
        EcuM_MainFunctionTimingEvent0 (RteBswEventToTaskMapping): RteBswUsedOsEventRef=Rte_Ev_Cyclic2_RunTask_OsCore0_0_10ms, RteBswUsedOsAlarmRef=Os/Rte_Al_TE2_RunTask_OsCore0_0_10ms
      Mcu
      PduR
      Port
    6 x RteSwComponentInstance:
      BswM_EcuSwComposition
        Timer_BswM_MainFunction (RteEventToTaskMapping): RteUsedOsEventRef=Rte_Ev_Run_BswM_BswM_MainFunction, RteUsedOsAlarmRef=Os/Rte_Al_TE_BswM_BswM_MainFunction
      ComM_EcuSwComposition
        Timer_ComM_MainFunction_0 (RteEventToTaskMapping): RteUsedOsEventRef=Rte_Ev_Cyclic2_RunTask_OsCore0_0_20ms, RteUsedOsAlarmRef=Os/Rte_Al_TE2_RunTask_OsCore0_0_20ms
      Det_EcuSwComposition
      ECU_APPM_EcuSwComposition
        TMT_ECU_APPM_Runnable (RteEventToTaskMapping): RteUsedOsAlarmRef=Os/Rte_Al_TE_ECU_APPM_ECU_APPM_Runnable
      EcuM_EcuSwComposition
        Timer_EcuM_MainFunction (RteEventToTaskMapping): RteUsedOsEventRef=Rte_Ev_Cyclic2_RunTask_OsCore0_0_10ms, RteUsedOsAlarmRef=Os/Rte_Al_TE2_RunTask_OsCore0_0_10ms
      Os_OsCore0_swc_EcuSwComposition
    RteOsInteraction
      4 x RteUsedOsActivation, all with RteExpectedActivationOffset=0:
        Rte_Al_TE_ECU_APPM_ECU_APPM_Runnable: RteActivationOsAlarmRef=Os/Rte_Al_TE_ECU_APPM_ECU_APPM_Runnable, RteActivationOsTaskRef=OsTask_APP_10ms_1
        Rte_Al_TE2_RunTask_OsCore0_0_10ms: RteActivationOsAlarmRef=Os/Rte_Al_TE2_RunTask_OsCore0_0_10ms, RteActivationOsTaskRef=RunTask_OsCore0
        Rte_Al_TE2_RunTask_OsCore0_0_20ms: RteActivationOsAlarmRef=Os/Rte_Al_TE2_RunTask_OsCore0_0_20ms, RteActivationOsTaskRef=RunTask_OsCore0
        Rte_Al_TE_BswM_BswM_MainFunction: RteActivationOsAlarmRef=Os/Rte_Al_TE_BswM_BswM_MainFunction, RteActivationOsTaskRef=RunTask_OsCore0
  module config NvM
  module config Os
    OsTask_APP_10ms_1 (OsTask): OsTaskActivation=1, OsTaskPriority=25, OsTaskSchedule=FULL
    Rte_Al_TE_ECU_APPM_ECU_APPM_Runnable (OsAlarm): OsAlarmCounterRef=OsCounter
      OsAlarmAction
        OsAlarmActivateTask: OsAlarmActivateTaskRef=OsTask_APP_10ms_1
    RunTask_OsCore0 (OsTask):
      OsTaskActivation = 1
      OsTaskPriority = 20
      OsTaskSchedule = FULL
      OsTaskEventRef = Rte_Ev_Cyclic2_RunTask_OsCore0_0_10ms
      OsTaskEventRef = Rte_Ev_Cyclic2_RunTask_OsCore0_0_20ms
      OsTaskEventRef = Rte_Ev_Run_BswM_BswM_MainFunction
    3 x OsAlarm, all with OsAlarmCounterRef=OsCounter:
      Rte_Al_TE2_RunTask_OsCore0_0_10ms
        OsAlarmAction
          OsAlarmSetEvent: OsAlarmSetEventRef=Rte_Ev_Cyclic2_RunTask_OsCore0_0_10ms, OsAlarmSetEventTaskRef=RunTask_OsCore0
      Rte_Al_TE2_RunTask_OsCore0_0_20ms
        OsAlarmAction
          OsAlarmSetEvent: OsAlarmSetEventRef=Rte_Ev_Cyclic2_RunTask_OsCore0_0_20ms, OsAlarmSetEventTaskRef=RunTask_OsCore0
      Rte_Al_TE_BswM_BswM_MainFunction
        OsAlarmAction
          OsAlarmSetEvent: OsAlarmSetEventRef=Rte_Ev_Run_BswM_BswM_MainFunction, OsAlarmSetEventTaskRef=RunTask_OsCore0
    3 x OsEvent:
      Rte_Ev_Cyclic2_RunTask_OsCore0_0_10ms
      Rte_Ev_Cyclic2_RunTask_OsCore0_0_20ms
      Rte_Ev_Run_BswM_BswM_MainFunction
  module config EcuC
  ecuc value collection DaVinci_Project: ecuc-values=[Com, Rte, Os, EcuC, NvM]
